# AST1080 register map
File version: 1.0
CPU: CM4 r0p1, little endian, MPU, FPU, 4 interrupt priority bits, 256 interrupts
Registers are 32-bit, read-write, reset 0x0 unless marked. A register's access mark holds for its fields unless they carry their own. Offsets are from the block's base; [hi:lo] are bit positions; {n}, {i} and the like mark numbered series.

## io_ahb_matrix
Base 0x740B0000
0x00 IO_AHB_MATRIX000 reset not defined — AHBM000 Register
0x04 IO_AHB_MATRIX004 reset not defined — AHBM004 Register
0x08 IO_AHB_MATRIX008 reset not defined — AHBM008 Register
0x0C IO_AHB_MATRIX00C reset not defined — AHBM00C Register
0x10 IO_AHB_MATRIX010 reset not defined — AHBM010 Register
0x14 IO_AHB_MATRIX014 reset not defined — AHBM014 Register
0x18 IO_AHB_MATRIX018 reset not defined — AHBM018 Register
0x1C IO_AHB_MATRIX01C reset not defined — AHBM01C Register
0x30 IO_AHB_MATRIX030 reset not defined — AHBM030 Register
0x34 IO_AHB_MATRIX034 reset 0x8 (reset mask 0x0) — AHBM034 Register
0x38 IO_AHB_MATRIX038 reset not defined — AHBM038 Register
{0xC+0x10*i} IO_AHB_MATRIX{i:02}C reset not defined (i=3..5) — AHBM{i:02}C Register
0x40 IO_AHB_MATRIX040 reset not defined — AHBM040 Register
0x44 IO_AHB_MATRIX044 reset not defined — AHBM044 Register
0x48 IO_AHB_MATRIX048 reset not defined — AHBM048 Register
0x50 IO_AHB_MATRIX050 reset not defined — AHBM050 Register
0x54 IO_AHB_MATRIX054 reset not defined — AHBM054 Register
0x58 IO_AHB_MATRIX058 reset not defined — AHBM058 Register
0x70 IO_AHB_MATRIX070 reset not defined — AHBM070 Register
0x74 IO_AHB_MATRIX074 reset 0x8 (reset mask 0x0) — AHBM074 Register
0x78 IO_AHB_MATRIX078 reset not defined — AHBM078 Register
{0xC+0x10*i} IO_AHB_MATRIX{i:02}C reset not defined (i=7..9) — AHBM{i:02}C Register
0x80 IO_AHB_MATRIX080 reset not defined — AHBM080 Register
0x84 IO_AHB_MATRIX084 reset not defined — AHBM084 Register
0x88 IO_AHB_MATRIX088 reset not defined — AHBM088 Register
0x90 IO_AHB_MATRIX090 reset not defined — AHBM090 Register
0x94 IO_AHB_MATRIX094 reset not defined — AHBM094 Register
0x98 IO_AHB_MATRIX098 reset not defined — AHBM098 Register
0xB0 IO_AHB_MATRIX0B0 reset not defined — AHBM0B0 Register
0xB4 IO_AHB_MATRIX0B4 reset 0x8 (reset mask 0x0) — AHBM0B4 Register
0xB8 IO_AHB_MATRIX0B8 reset not defined — AHBM0B8 Register
0xBC IO_AHB_MATRIX0BC reset not defined — AHBM0BC Register
0xC0 IO_AHB_MATRIX0C0 reset not defined — AHBM0C0 Register
0xC4 IO_AHB_MATRIX0C4 reset not defined — AHBM0C4 Register
0xC8 IO_AHB_MATRIX0C8 reset not defined — AHBM0C8 Register
0xCC IO_AHB_MATRIX0CC reset not defined — AHBM0CC Register
0xD0 IO_AHB_MATRIX0D0 reset not defined — AHBM0D0 Register
0xD4 IO_AHB_MATRIX0D4 reset not defined — AHBM0D4 Register
0xD8 IO_AHB_MATRIX0D8 reset not defined — AHBM0D8 Register
0xDC IO_AHB_MATRIX0DC reset not defined — AHBM0DC Register
0xF0 IO_AHB_MATRIX0F0 reset not defined — AHBM0F0 Register
0xF4 IO_AHB_MATRIX0F4 reset 0x8 (reset mask 0x0) — AHBM0F4 Register
0xF8 IO_AHB_MATRIX0F8 reset not defined — AHBM0F8 Register
{0xFC+0x100*i} IO_AHB_MATRIX{i}FC reset not defined (i=0..2) — AHBM{i}FC Register
0x100 IO_AHB_MATRIX100 reset not defined — AHBM100 Register
0x104 IO_AHB_MATRIX104 reset not defined — AHBM104 Register
0x108 IO_AHB_MATRIX108 reset not defined — AHBM108 Register
0x10C IO_AHB_MATRIX10C reset not defined — AHBM10C Register
0x110 IO_AHB_MATRIX110 reset not defined — AHBM110 Register
0x114 IO_AHB_MATRIX114 reset not defined — AHBM114 Register
0x118 IO_AHB_MATRIX118 reset not defined — AHBM118 Register
0x11C IO_AHB_MATRIX11C reset not defined — AHBM11C Register
0x130 IO_AHB_MATRIX130 reset not defined — AHBM130 Register
0x134 IO_AHB_MATRIX134 reset 0x8 (reset mask 0x0) — AHBM134 Register
0x138 IO_AHB_MATRIX138 reset not defined — AHBM138 Register
{0x6C+0x10*i} IO_AHB_MATRIX{i}C reset not defined (i=13..15) — AHBM{i}C Register
0x140 IO_AHB_MATRIX140 reset not defined — AHBM140 Register
0x144 IO_AHB_MATRIX144 reset not defined — AHBM144 Register
0x148 IO_AHB_MATRIX148 reset not defined — AHBM148 Register
0x150 IO_AHB_MATRIX150 reset not defined — AHBM150 Register
0x154 IO_AHB_MATRIX154 reset not defined — AHBM154 Register
0x158 IO_AHB_MATRIX158 reset not defined — AHBM158 Register
0x170 IO_AHB_MATRIX170 reset not defined — AHBM170 Register
0x174 IO_AHB_MATRIX174 reset 0x8 (reset mask 0x0) — AHBM174 Register
0x178 IO_AHB_MATRIX178 reset not defined — AHBM178 Register
{0x6C+0x10*i} IO_AHB_MATRIX{i}C reset not defined (i=17..19) — AHBM{i}C Register
0x180 IO_AHB_MATRIX180 reset not defined — AHBM180 Register
0x184 IO_AHB_MATRIX184 reset not defined — AHBM184 Register
0x188 IO_AHB_MATRIX188 reset not defined — AHBM188 Register
0x190 IO_AHB_MATRIX190 reset not defined — AHBM190 Register
0x194 IO_AHB_MATRIX194 reset not defined — AHBM194 Register
0x198 IO_AHB_MATRIX198 reset not defined — AHBM198 Register
0x1B0 IO_AHB_MATRIX1B0 reset not defined — AHBM1B0 Register
0x1B4 IO_AHB_MATRIX1B4 reset 0x8 (reset mask 0x0) — AHBM1B4 Register
0x1B8 IO_AHB_MATRIX1B8 reset not defined — AHBM1B8 Register
0x1BC IO_AHB_MATRIX1BC reset not defined — AHBM1BC Register
0x1C0 IO_AHB_MATRIX1C0 reset not defined — AHBM1C0 Register
0x1C4 IO_AHB_MATRIX1C4 reset not defined — AHBM1C4 Register
0x1C8 IO_AHB_MATRIX1C8 reset not defined — AHBM1C8 Register
0x1CC IO_AHB_MATRIX1CC reset not defined — AHBM1CC Register
0x1D0 IO_AHB_MATRIX1D0 reset not defined — AHBM1D0 Register
0x1D4 IO_AHB_MATRIX1D4 reset not defined — AHBM1D4 Register
0x1D8 IO_AHB_MATRIX1D8 reset not defined — AHBM1D8 Register
0x1DC IO_AHB_MATRIX1DC reset not defined — AHBM1DC Register
0x1F0 IO_AHB_MATRIX1F0 reset not defined — AHBM1F0 Register
0x1F4 IO_AHB_MATRIX1F4 reset 0x8 (reset mask 0x0) — AHBM1F4 Register
0x1F8 IO_AHB_MATRIX1F8 reset not defined — AHBM1F8 Register
0x200 IO_AHB_MATRIX200 reset not defined — AHBM200 Register
0x204 IO_AHB_MATRIX204 reset not defined — AHBM204 Register
0x208 IO_AHB_MATRIX208 reset not defined — AHBM208 Register
{0xCC+0x10*i} IO_AHB_MATRIX{i}C reset not defined (i=20..23) — AHBM{i}C Register
0x210 IO_AHB_MATRIX210 reset not defined — AHBM210 Register
0x214 IO_AHB_MATRIX214 reset not defined — AHBM214 Register
0x218 IO_AHB_MATRIX218 reset not defined — AHBM218 Register
0x220 IO_AHB_MATRIX220 reset 0xFFFFFFFF (reset mask 0x0) — AHBM220 Register
0x224 IO_AHB_MATRIX224 reset 0x7 (reset mask 0x0) — AHBM224 Register
0x228 IO_AHB_MATRIX228 reset not defined — AHBM228 Register
0x230 IO_AHB_MATRIX230 reset 0xFFFFFFFF (reset mask 0x0) — AHBM230 Register
0x234 IO_AHB_MATRIX234 reset 0x7 (reset mask 0x0) — AHBM234 Register
0x238 IO_AHB_MATRIX238 reset not defined — AHBM238 Register
0x260 IO_AHB_MATRIX260 reset 0xFFFFFFFF (reset mask 0x0) — AHBM260 Register
0x264 IO_AHB_MATRIX264 reset 0x7 (reset mask 0x0) — AHBM264 Register
0x268 IO_AHB_MATRIX268 reset not defined — AHBM268 Register
0x26C IO_AHB_MATRIX26C reset not defined — AHBM26C Register
0x270 IO_AHB_MATRIX270 reset 0xFFFFFFFF (reset mask 0x0) — AHBM270 Register
0x274 IO_AHB_MATRIX274 reset 0x7 (reset mask 0x0) — AHBM274 Register
0x278 IO_AHB_MATRIX278 reset not defined — AHBM278 Register
0x27C IO_AHB_MATRIX27C reset not defined — AHBM27C Register
0x2A0 IO_AHB_MATRIX2A0 reset 0xF00 (reset mask 0x0) — AHBM2A0 Register
0x2A4 IO_AHB_MATRIX2A4 reset not defined — AHBM2A4 Register
0x2A8 IO_AHB_MATRIX2A8 reset 0x100 (reset mask 0x0) — AHBM2A8 Register
0x2AC IO_AHB_MATRIX2AC reset not defined — AHBM2AC Register
