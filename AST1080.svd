# AST1080 register map
File version: 1.0
CPU: CM4 r0p1, little endian, MPU, FPU, 4 interrupt priority bits, 256 interrupts
Registers are 32-bit, read-write, reset 0x0 unless marked. A register's access mark holds for its fields unless they carry their own. Offsets are from the block's base; lines under a group give offsets from that group; [hi:lo] are bit positions; {n}, {i} and the like mark numbered series; 'fields as' and 'values as' point back to an identical list; <NAME> marks a mode.

## Memory map
0x00000000 usb20 size 0x2000
0x74000000 spi size 0x200
0x74000400 spif size 0x314
0x74000800 sprot size 0x100
0x74010000 spi1 size 0x200 — spi interface
0x74010800 sprot1 size 0x100 — sprot interface
0x74020000 spi2 size 0x200 — spi interface
0x74020800 sprot2 size 0x100 — sprot interface
0x740B0000 io_ahb_matrix size 0x300
0x74100000 pric_io size 0x500
0x74110000 uhci size 0x90
0x74121000 ehci size 0x90
0x74122000 usb201 size 0x2000 — usb20 interface
0x74123000 ehci1 size 0x90 — ehci interface
0x74130000 vic size 0x8A0
0x74B80000 gsram size 0x180
0x74C00000 adc size 0x1D0
0x74C01000 jtag size 0x40
0x74C02000 scu size 0xF7C
0x74C03000 wdt size 0x80
0x74C03080 wdt1 size 0x80 — wdt interface
0x74C03100 wdt2 size 0x80 — wdt interface
0x74C03180 wdt3 size 0x80 — wdt interface
0x74C03200 wdt4 size 0x80 — wdt interface
0x74C03280 wdt5 size 0x80 — wdt interface
0x74C03300 wdt6 size 0x80 — wdt interface
0x74C03380 wdt7 size 0x80 — wdt interface
0x74C07000 otp_reg size 0x330
0x74C0B000 gpio size 0xE30
0x74C0C000 sgpio size 0x490
0x74C0D000 sgpio1 size 0x490 — sgpio interface
0x74C0F000 i2cglobal size 0x24
0x74C0F100 i2c size 0x1000
0x74C0F1A0 i2cbuff size 0x20
{0x74C0F100+0x100*n} i2c{n} size 0x1000 (n=1..13) — i2c interface
{0x74C0F1A0+0x100*n} i2cbuff{n} size 0x20 (n=1..13) — i2cbuff interface
0x74C12000 uartdma size 0x240
0x74C14000 i2c_filter size 0x10
0x74C14200 i2c_filter_thr size 0x100
0x74C14300 i2c_filter_thr1 size 0x100 — i2c_filter_thr interface
0x74C14400 i2c_filter_thr2 size 0x100 — i2c_filter_thr interface
0x74C14500 i2c_filter_thr3 size 0x100 — i2c_filter_thr interface
0x74C15000 spipf size 0x300
0x74C16000 spipf1 size 0x300 — spipf interface
0x74C17000 spipf2 size 0x300 — spipf interface
0x74C20000 i3c size 0x1000
0x74C21000 i3c1 size 0x1000 — i3c interface
0x74C22000 i3c2 size 0x1000 — i3c interface
0x74C23000 i3c3 size 0x1000 — i3c interface
0x74C24000 i3c4 size 0x1000 — i3c interface
0x74C25000 i3c5 size 0x1000 — i3c interface
0x74C26000 i3c6 size 0x1000 — i3c interface
0x74C27000 i3c7 size 0x1000 — i3c interface
0x74C33000 uart size 0x100
0x74C33100 uart1 size 0x100 — uart interface
0x74C33200 uart2 size 0x100 — uart interface
0x74C33300 uart3 size 0x100 — uart interface
0x74C33400 uart4 size 0x100 — uart interface
0x74C33C00 uart5 size 0x100 — uart interface
0x74C34000 rtc size 0x18
0x74C35000 at size 0x100
0x74C39000 ipc size 0x100
0x74C39100 ipc1 size 0x100 — ipc interface
0x74C39200 ipc2 size 0x100 — ipc interface
0x74C39300 ipc3 size 0x100 — ipc interface
0x74C39400 ipc4 size 0x100 — ipc interface
0x74C39500 ipc5 size 0x100 — ipc interface
0x74C3A000 timer size 0x40
0x74C3A040 timer1 size 0x40 — timer interface
0x74C3A080 timer2 size 0x40 — timer interface
0x74C3A0C0 timer3 size 0x40 — timer interface
0x74C3A100 timer4 size 0x40 — timer interface
0x74C3A140 timer5 size 0x40 — timer interface
0x74C3A180 timer6 size 0x40 — timer interface
0x74C3A1C0 timer7 size 0x40 — timer interface

## Interrupts
64 i2c
{n+64} i2c{n} (n=1..13)
80 adc
82 gpio
84 sgpio
88 sgpio1
91 rtc
92 timer
93 timer1
94 timer2
95 timer3
96 i3c
97 i3c1
98 i3c2
99 i3c3
100 i3c4
101 i3c5
102 i3c6
103 i3c7
112 wdt
113 wdt1
114 wdt2
115 wdt3
116 wdt4
117 wdt5
118 wdt6
119 wdt7
121 spi
122 spi1
123 spi2
126 io_ahb_matrix
131 timer4
132 timer5
133 timer6
134 timer7
135 uart
136 uart1
137 uart2
138 uart3
139 uart4
147 uart5
148 uartdma
155 uhci
156 ehci
156 usb20
157 ehci1
157 usb201
159 scu
162 jtag
168 otp_reg
169 gsram
170 at
174 ipc
175 ipc1
176 ipc2
177 ipc3
178 ipc4
179 ipc5

## Notices in the file
Copyright (c) 2025 ASPEED Technology.
SPDX-License-Identifier: Apache-2.0
Licensed under the Apache License, Version 2.0 (the "License");
you may not use this file except in compliance with the License.
You may obtain a copy of the License at
http://www.apache.org/licenses/LICENSE-2.0
Unless required by applicable law or agreed to in writing, software
distributed under the License is distributed on an "AS IS" BASIS,
WITHOUT WARRANTIES OR CONDITIONS OF ANY KIND, either express or
implied. See the License for the specific language governing
permissions and limitations under the License.
